//////////////////////////////////////////////////////////////////////////////////	 
//本程序只供学习使用，未经作者许可，不得用于其他用途
//技术资料唯一网站：http://www.weilaishijiejiqiren.icoc.me/
//单片机交流群：439190573
//淘宝店：https://shop130205202.taobao.com
//修改日期：2018/11/1
//版本：V3.0
//版权所有，盗版必究。
//未来世界机器人系列
//////////////////////////////////////////////////////////////////////////////////
#include "uart.h"


/*********************************************************************
 *  函数名称：uart_Init
 *  函数功能：串口初始化
 *  形    参：无
 *  输    出：无
 *  备    注：无
 ********************************************************************/
 void uart_Init()
 {
   WL_SERIAL.begin(9600);
 }
/*********************************************************************
 *  函数名称：Read_Data
 *  函数功能：读取数据
 *  形    参：*Data: 读取到的数据
 *  输    出：无
 *  备    注：无
 ********************************************************************/
void Read_Data(unsigned int *Data)	       
{	
  unsigned char y = 0;
  unsigned char USART_RX_STA[3] = { 0 };       //数据缓存区
  unsigned char Num = 0;              //数组计数
  unsigned int Receive_data = 0;       //数据缓存区
	
  WL_SERIAL.write(0x57);
 ///////////////////////////数字量数值///////////////////////////////	
 
  for(y=0;y <= 5;y++)
  {
    delay(1);
    if(WL_SERIAL.available() > 0)
    {
      USART_RX_STA[Num++] = WL_SERIAL.read();	//依次读取接收到的数据
      if(Num == 1)
      {
        Num = 0;
        *Data = USART_RX_STA[0];
        break;
      }
    } 
  }
  
///////////////////////////数字量数值///////////////////////////////	

///////////////////////////偏移量数值///////////////////////////////

//  for(y=0;y <= 10;y++)
//  {
//    delay(1);
//    if(WL_SERIAL.available() > 0)
//    {
//      USART_RX_STA[Num++] = WL_SERIAL.read();	//依次读取接收到的数据
//      if(Num == 3)
//      {
//        Num = 0;
//        
//        Receive_data = USART_RX_STA[1];
//        Receive_data <<= 8;
//        Receive_data |= USART_RX_STA[2];
//        
//        *Data = USART_RX_STA[0];
//        *(Data+1) = Receive_data;
//        
//        break;
//      }
//    } 
//  }
  
///////////////////////////偏移量数值///////////////////////////////	
	
}

